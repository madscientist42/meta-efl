## conf/layer.conf
```bitbake
# We have a conf and classes directory, add to BBPATH
BBPATH .= ":${LAYERDIR}"

# We have recipes-* directories, add to BBFILES
BBFILES += " \
	${LAYERDIR}/recipes-*/*/*.bb \
	${LAYERDIR}/recipes-*/*/*.bbappend \
	${LAYERDIR}/*/recipes-*/*/*.bb \
	${LAYERDIR}/*/recipes-*/*/*.bbappend \
	"

BBFILE_COLLECTIONS += "efl"
BBFILE_PATTERN:efl = "^${LAYERDIR}/"
BBFILE_PRIORITY:efl = "11"
LAYERVERSION:efl = "7"


# This reflects which version series of Yocto/OE that this layer
# is supposed to be built with.  For any new-ish version of the same,
# you should add the codename for the version series (eg. "dunfell", etc.)
# to this list, separated by spaces...  Generally, this only applies for
# up to four or five roughly compatible versions...usually the latest
# stable and back or close to it.
LAYERSERIES_COMPAT:efl = "dunfell gatesgarth hardknott "
```
